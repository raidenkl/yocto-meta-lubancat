## meta-lubancat/conf/machine/include/lubancat-rk3562.inc
```bitbake
# LubanCat RK3562 系列公共配置（LubanCat-1HS / 1HS-test）
#
# rk3562.inc 没设 KBUILD_DEFCONFIG，落到 rockchip_linux_defconfig，必须覆盖。

require conf/machine/include/rk3562.inc

MACHINEOVERRIDES =. "lubancat:lubancat-rk3562:"

PREFERRED_PROVIDER_virtual/kernel ?= "linux-rockchip"
PREFERRED_VERSION_linux-rockchip ?= "6.1%"
PREFERRED_PROVIDER_virtual/bootloader ?= "u-boot-rockchip"

KBUILD_DEFCONFIG = "lubancat_linux_rk3562_defconfig"

SERIAL_CONSOLES = "1500000;ttyFIQ0"
SERIAL_CONSOLES_CHECK = "${SERIAL_CONSOLES}"

KERNEL_IMAGETYPE = "Image"
WKS_FILE ?= "lubancat-gptdisk.wks.in"
IMAGE_FSTYPES ?= "wic.gz ext4 tar"

LUBANCAT_RKBIN_INI ?= "RK3562MINIALL.ini"
LUBANCAT_DDR_BIN ?= "rk3562_ddr_1332MHz_v1.07.bin"

MACHINE_EXTRA_RRECOMMENDS += "kernel-modules"

# ---- extboot / dtbo / uEnv 族级变量 ----
LUBANCAT_FAMILY ?= "rk3562"
LUBANCAT_CPU_SYMBOL ?= "RK3562"
LUBANCAT_DTB ?= "rk3562-lubancat-1hs.dtb"
LUBANCAT_UENV_DIR ?= "rk3562"
LUBANCAT_UENV ?= "uEnvLubanCat1HS.txt"
LUBANCAT_CMDLINE ?= "earlyprintk console=ttyFIQ0,1500000n8 console=tty1 consoleblank=0 loglevel=7 rootwait rw rootfstype=ext4"
LUBANCAT_UBOOT_FRAGMENT ?= ""
LUBANCAT_UBOOT_CFG ?= "${RK_SOC_FAMILY}"
```

## meta-lubancat/conf/machine/lubancat-rk3562.conf
```bitbake
#@TYPE: Machine
#@NAME: LubanCat RK3562 family
#@DESCRIPTION: 族级 machine：覆盖 LubanCat-1HS / 1HS-test（RK3562）。

require conf/machine/include/lubancat-rk3562.inc

MACHINE_FEATURES = "usbhost usbgadget alsa screen ext2"

KERNEL_DEVICETREE = "rockchip/rk3562-lubancat-generic.dtb"
# 族镜像默认用 generic dtb 启动：它在本族所有板子上都能起（U-Boot 早期阶段也用这一份，
# 所以 eMMC/串口必须够用）。首次启动由 lubancat-board-detect 读 SARADC 板卡 ID，
# 把 /rk-kernel.dtb 换成对应板子的那份，再重启一次。
LUBANCAT_FIRSTBOOT_SWITCH ?= "1"

LUBANCAT_FAMILY_ALL_DTBS ?= "1"

UBOOT_MACHINE = "rk3562_defconfig"

LUBANCAT_DTB ?= "rk3562-lubancat-generic.dtb"
LUBANCAT_UENV ?= "uEnvLubanCat.txt"
```
